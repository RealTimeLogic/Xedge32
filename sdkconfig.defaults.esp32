## sdkconfig.defaults.esp32
```kconfig
#
# SPIRAM workaround libraries placement
#
CONFIG_SPIRAM_CACHE_LIBJMP_IN_IRAM=n
CONFIG_SPIRAM_CACHE_LIBMATH_IN_IRAM=n
CONFIG_SPIRAM_CACHE_LIBNUMPARSER_IN_IRAM=n
CONFIG_SPIRAM_CACHE_LIBIO_IN_IRAM=n
CONFIG_SPIRAM_CACHE_LIBTIME_IN_IRAM=n
CONFIG_SPIRAM_CACHE_LIBCHAR_IN_IRAM=n
CONFIG_SPIRAM_CACHE_LIBMEM_IN_IRAM=n
CONFIG_SPIRAM_CACHE_LIBSTR_IN_IRAM=n
CONFIG_SPIRAM_CACHE_LIBRAND_IN_IRAM=n
CONFIG_SPIRAM_CACHE_LIBENV_IN_IRAM=n
CONFIG_SPIRAM_CACHE_LIBFILE_IN_IRAM=n
CONFIG_SPIRAM_CACHE_LIBMISC_IN_IRAM=n
# end of SPIRAM workaround libraries placement

# Flash Partition Table
CONFIG_PARTITION_TABLE_CUSTOM=y
CONFIG_PARTITION_TABLE_CUSTOM_FILENAME="ESP32-partitions.csv"

# Ethernet for IDF v6
CONFIG_ETH_ENABLED=n
CONFIG_ETH_USE_SPI_ETHERNET=n
CONFIG_ETH_USE_ESP32_EMAC=n

# Flash Size
CONFIG_ESPTOOLPY_FLASHSIZE_4MB=y

# CPU Frequency
CONFIG_ESP_DEFAULT_CPU_FREQ_MHZ_240=y

# Development profile; release variants override OPC UA and console settings.
CONFIG_CAM_ENABLED=y
CONFIG_mDNS_ENABLED=y
CONFIG_OPCUA_ENABLED=n
CONFIG_ESP_CONSOLE_UART_DEFAULT=y
CONFIG_GRAB_WHEN_EMPTY=y
CONFIG_FB_ONE=y
```

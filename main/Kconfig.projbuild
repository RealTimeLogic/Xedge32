## main/Kconfig.projbuild
```kconfig
menu "Xedge config"
   
   menu "Camera"
 #     depends on IDF_TARGET_ESP32 || IDF_TARGET_ESP32S3
      config CAM_ENABLED
	      bool "Enable camera module"
	      default n
	      help
		      Includes in the compilation the CAM module, note that it is not compatible with the esp32 standard.
		         

      if CAM_ENABLED
         choice CAM_GRAB
            prompt "Image capturing mode"
            default GRAB_WHEN_EMPTY
            help
              Select the camera capturing images mode.

            config GRAB_WHEN_EMPTY
              bool "EMPTY"
              help
                  Fills buffers when they are empty. Less resources but first 'fb_count' frames might be old.

            config GRAB_LATEST
              bool "LATEST"
              help
                  Except when 1 frame buffer is used, queue will always contain the last 'fb_count' frames.
         endchoice

         choice CAM_FB_COUNT
            prompt "Number of frame buffers"
            default FB_ONE
            help
              Select number of frame buffers.

            config FB_ONE
              bool "ONE"
              help
                  Normal speed.

            config FB_TWO
              bool "TWO"
              help
                  Two double speed.
         endchoice
      endif # CAM_ENABLED
   endmenu

   menu "Connection"
      
      config WIFI_SCAN_RSSI_THRESHOLD
          int "WiFi minimum rssi"
          range -127 0
          default -127
          help
              The minimum rssi to accept in the scan mode.

      config ETHERNET_EMAC_TASK_STACK_SIZE
         int "emac_rx task stack size"
         default 2048
         depends on ETH_USE_ESP32_EMAC || ETH_USE_SPI_ETHERNET
         help
            This set stack size for emac_rx task

      config ETHERNET_PHY_ADDR
         int "PHY Address"
         range 0 31 if ETH_USE_ESP32_EMAC
         default 1
         depends on ETH_USE_ESP32_EMAC || ETH_USE_SPI_ETHERNET
         help
            Set PHY address according your board schematic.

      # PHY hardware devices for RMII internal interface (Only visible if native EMAC is enabled)
      if ETH_USE_ESP32_EMAC
          choice XEDGE_ETH_INTERNAL_PHY
              prompt "Internal EMAC PHY Device"
              default XEDGE_ETH_PHY_IP101

              config XEDGE_ETH_PHY_IP101
                  bool "IC Plus IP101"
              config XEDGE_ETH_PHY_LAN8720
                  bool "Microchip LAN8720"
              config XEDGE_ETH_PHY_DP83848
                  bool "TI DP83848"
              config XEDGE_ETH_PHY_KSZ8041
                  bool "Microchip KSZ8041"
              config XEDGE_ETH_PHY_RTL8201
                  bool "CoreChip RTL8201"
          endchoice
      endif

      # PHY hardware devices for SPI interface (Only visible if native SPI Eth is enabled)
      if ETH_USE_SPI_ETHERNET
          choice XEDGE_ETH_SPI_DEVICE
              prompt "SPI Ethernet Module"
              default XEDGE_ETH_PHY_W5500

              config XEDGE_ETH_PHY_W5500
                  bool "Wiznet W5500"
              config XEDGE_ETH_PHY_DM9051
                  bool "Davicom DM9051"
          endchoice
      endif
     
      config XEDGE_WIFI_ENABLED
         bool "Enable Wi-Fi features"
         default y
         help
            Enable native Wi-Fi support (Station and AP).

      menu "Wifi AP"
       depends on XEDGE_WIFI_ENABLED
      	
       config WIFI_AP_SSID
           string "WiFi SSID"
           default "xedge32"
           help
               SSID (network name) for to connect to.

       config WIFI_AP_PASSWORD
           string "WiFi Password"
           default "12345678"
           help
               WiFi password (WPA or WPA2) minimun 8 characters.
       config WIFI_AP_CHANNEL
           int "WiFi Channel"
           range 1 13
           default 1
           help
               WiFi channel (network channel).

       config WIFI_AP_MAX_STA_CONN
           int "Maximal STA connections"
           default 4
           help
               Max number of the STA connects to AP.
      
       menu "Network Settings"

          config WIFI_AP_IP_ADDR
              string "IP Address"
              default "192.168.190.0"

          config WIFI_AP_GATEWAY
              string "Gateway"
              default "192.168.190.0"

          config WIFI_AP_NETMASK
              string "Netmask"
              default "255.0.0.0"

       endmenu
      endmenu
   endmenu

   menu "mDNS"
      config mDNS_ENABLED
         bool "Enable mDNS"
      default n
      help
             Enable mDNS - zeroconf
   endmenu

   menu "OPC UA"
      config OPCUA_ENABLED
         bool "Enable OPC UA"
      default n
      help
             Enabling this is required if you build BAS-Resources:Xedge with OPC UA
   endmenu

   menu "softTPM"
      config softTPM_EFUSE_ENABLED
         bool "Use eFuse"
      default n
      help
             Use Efuse for storing soft TPM (Trusted Platform Module) key
   endmenu
   
   menu "Debug Threads"
      config DEBUG_THREADS
         bool "Enable Debug Threads"
         default n
         select FREERTOS_USE_TRACE_FACILITY
         help
             Enable this option to enable debugging of threads.
             Automatically sets CONFIG_FREERTOS_USE_TRACE_FACILITY to y.
   endmenu
endmenu
```

## sdkconfig.defaults
```kconfig
# Watchdog does not work when server is idle.
CONFIG_ESP_TASK_WDT_CHECK_IDLE_TASK_CPU0=n
CONFIG_ESP_TASK_WDT_CHECK_IDLE_TASK_CPU1=n

CONFIG_ADC_CONTINUOUS_ISR_IRAM_SAFE=y

#CONFIG_PARTITION_TABLE_CUSTOM=y
CONFIG_COMPILER_OPTIMIZATION_PERF=y
CONFIG_SPIRAM=y
CONFIG_SPIRAM_BOOT_INIT=y
CONFIG_SPIRAM_USE_MALLOC=y
CONFIG_SPIRAM_MEMTEST=y
CONFIG_SPIRAM_MALLOC_ALWAYSINTERNAL=16384
CONFIG_SPIRAM_MALLOC_RESERVE_INTERNAL=32768
CONFIG_SPIRAM_ALLOW_BSS_SEG_EXTERNAL_MEMORY=y
CONFIG_FATFS_ALLOC_PREFER_EXTRAM=y
CONFIG_FATFS_LFN_HEAP=y
CONFIG_FATFS_LFN_NONE=n
CONFIG_FREERTOS_HZ=1000
CONFIG_LWIP_LOCAL_HOSTNAME="xedge"
CONFIG_LWIP_IRAM_OPTIMIZATION=y
CONFIG_LWIP_MAX_SOCKETS=16
CONFIG_LWIP_IP4_REASSEMBLY=y
CONFIG_LWIP_MAX_ACTIVE_TCP=32
CONFIG_LWIP_TCP_WND_DEFAULT=14360
CONFIG_LWIP_TCP_RECVMBOX_SIZE=12
CONFIG_SPIRAM_TRY_ALLOCATE_WIFI_LWIP=y
# Enables the bundle infrastructure (necessary due to dependencies)
CONFIG_MBEDTLS_CERTIFICATE_BUNDLE=y

# Select the option not to include certificates by default
CONFIG_MBEDTLS_CERTIFICATE_BUNDLE_DEFAULT_CMN=y

# Optional: Define the maximum number of certificates
CONFIG_MBEDTLS_CERTIFICATE_BUNDLE_MAX_CERTS=200

CONFIG_FREERTOS_USE_TRACE_FACILITY=n

CONFIG_ESPTOOLPY_HEADER_FLASHSIZE_UPDATE=y

CONFIG_ESP_SYSTEM_EVENT_TASK_STACK_SIZE=8192
```

## sdkconfig.defaults.camera
```kconfig
# Xedge32 Camera Settings
CONFIG_GRAB_LATEST=y
CONFIG_FB_TWO=y

CONFIG_CAMERA_TASK_STACK_SIZE=4048
CONFIG_OV7670_SUPPORT=n
CONFIG_OV7725_SUPPORT=n
CONFIG_NT99141_SUPPORT=n
CONFIG_OV2640_SUPPORT=y
CONFIG_OV3660_SUPPORT=y
CONFIG_OV5640_SUPPORT=y
CONFIG_GC2145_SUPPORT=n
CONFIG_GC032A_SUPPORT=n
CONFIG_GC0308_SUPPORT=n
CONFIG_BF3005_SUPPORT=n
CONFIG_BF20A6_SUPPORT=n
CONFIG_SC030IOT_SUPPORT=n
```

## sdkconfig.defaults.esp32s3
```kconfig
# Flash Size
CONFIG_ESPTOOLPY_FLASHSIZE_8MB=y

# CPU Frequency 
CONFIG_ESP_DEFAULT_CPU_FREQ_MHZ_240=y

# PSRAM 
CONFIG_SPIRAM_SPEED_80M=y
CONFIG_SPIRAM_TYPE_AUTO=y
CONFIG_SPIRAM_MODE_OCT=y

# Console output
CONFIG_ESP_CONSOLE_USB_SERIAL_JTAG=y

# Flash Partition Table
CONFIG_PARTITION_TABLE_CUSTOM=y
CONFIG_PARTITION_TABLE_CUSTOM_FILENAME="ESP32s3-partitions.csv"

# Ethernet for IDF v6
CONFIG_ETH_ENABLED=y
CONFIG_ETH_USE_SPI_ETHERNET=y
CONFIG_ETH_USE_ESP32_EMAC=n
CONFIG_XEDGE_ETH_PHY_W5500=y
```
